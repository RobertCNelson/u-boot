## configs/Bananapi_M2_Ultra_defconfig
```kconfig
# CONFIG_B43LEGACY_DEBUG is not set
# CONFIG_B43LEGACY_DMA_MODE is not set
# CONFIG_B43LEGACY_PIO_MODE is not set
# CONFIG_B43_DEBUG is not set
# CONFIG_BCMDHD_SDIO_IRQ is not set
# CONFIG_BRCMDBG is not set
# CONFIG_BRCM_TRACING is not set
# CONFIG_HW_RANDOM is not set
# CONFIG_INET_DIAG is not set
# CONFIG_INET_XFRM_MODE_BEET is not set
# CONFIG_INET_XFRM_MODE_TRANSPORT is not set
# CONFIG_INET_XFRM_MODE_TUNNEL is not set
# CONFIG_INPUT_MOUSE is not set
# CONFIG_IOMMU_SUPPORT is not set
# CONFIG_IPV6 is not set
# CONFIG_LIBERTAS_DEBUG is not set
# CONFIG_LIBERTAS_MESH is not set
# CONFIG_NET_CADENCE is not set
# CONFIG_NET_VENDOR_ARC is not set
# CONFIG_NET_VENDOR_BROADCOM is not set
# CONFIG_NET_VENDOR_CIRRUS is not set
# CONFIG_NET_VENDOR_FARADAY is not set
# CONFIG_NET_VENDOR_INTEL is not set
# CONFIG_NET_VENDOR_MARVELL is not set
# CONFIG_NET_VENDOR_MICREL is not set
# CONFIG_NET_VENDOR_MICROCHIP is not set
# CONFIG_NET_VENDOR_NATSEMI is not set
# CONFIG_NET_VENDOR_SAMSUNG is not set
# CONFIG_NET_VENDOR_SEEQ is not set
# CONFIG_NET_VENDOR_SMSC is not set
# CONFIG_NET_VENDOR_VIA is not set
# CONFIG_NET_VENDOR_WIZNET is not set
# CONFIG_P54_SPI_DEFAULT_EEPROM is not set
# CONFIG_RT2800USB_UNKNOWN is not set
# CONFIG_RT2X00_DEBUG is not set
# CONFIG_RTC_INTF_PROC is not set
# CONFIG_RTC_INTF_SYSFS is not set
# CONFIG_RTLWIFI_DEBUG is not set
# CONFIG_SYS_MALLOC_CLEAR_ON_INIT is not set
# CONFIG_SYS_USB_EVENT_POLL_VIA_INT_QUEUE=y
# CONFIG_WLAN is not set
# CONFIG_ZD1211RW_DEBUG is not set
CONFIG_AEABI=y
CONFIG_AHCI=y
CONFIG_AHCI_SUNXI=y
CONFIG_ARCH_SUNXI=y
CONFIG_ARM=y
CONFIG_ARM_APPENDED_DTB=y
CONFIG_ARM_ATAG_DTB_COMPAT=y
CONFIG_ATA=y
CONFIG_AXP20X_ADC=y
CONFIG_AXP20X_POWER=y
CONFIG_AXP_DLDO2_VOLT=3300
CONFIG_AXP_DLDO3_VOLT=3300
CONFIG_AXP_DLDO4_VOLT=2500
CONFIG_AXP_ELDO3_VOLT=1200
CONFIG_AXP_GPIO=y
CONFIG_B43=m
CONFIG_B43LEGACY=m
CONFIG_B43LEGACY_DMA=y
CONFIG_B43LEGACY_DMA_AND_PIO_MODE=y
CONFIG_B43LEGACY_LEDS=y
CONFIG_B43LEGACY_PIO=y
CONFIG_B43_LEDS=y
CONFIG_B43_PHY_LP=y
CONFIG_B43_PHY_N=y
CONFIG_B43_PIO=y
CONFIG_B43_SDIO=m
CONFIG_B43_SSB=y
CONFIG_BATTERY_AXP20X=y
CONFIG_BCMDHD=m
CONFIG_BCMDHD_FW_PATH="/etc/firmware/fw_bcm43438a0.bin"
CONFIG_BCMDHD_NVRAM_PATH="/etc/firmware/nvram_ap6212.txt"
CONFIG_BCMDHD_OOB=y
CONFIG_BCMDHD_SDIO=y
CONFIG_BCM_BT_LPM=m
CONFIG_BLK_DEV_INITRD=y
CONFIG_BLK_DEV_SD=y
CONFIG_BRCMDBG=y
CONFIG_BRCMFMAC=m
CONFIG_BRCMFMAC_SDIO=y
CONFIG_BRCMFMAC_USB=y
CONFIG_BRCMUTIL=m
CONFIG_BT=y
CONFIG_BT_BNEP=y
CONFIG_BT_BNEP_MC_FILTER=y
CONFIG_BT_BNEP_PROTO_FILTER=y
CONFIG_BT_CMTP=m
CONFIG_BT_HCIBCM203X=m
CONFIG_BT_HCIBFUSB=m
CONFIG_BT_HCIBLUECARD=m
CONFIG_BT_HCIBPA10X=m
CONFIG_BT_HCIBT3C=m
CONFIG_BT_HCIBTSDIO=m
CONFIG_BT_HCIBTUSB=m
CONFIG_BT_HCIDTL1=m
CONFIG_BT_HCIUART=m
CONFIG_BT_HCIUART_3WIRE=y
CONFIG_BT_HCIUART_ATH3K=y
CONFIG_BT_HCIUART_BCM=y
CONFIG_BT_HCIUART_BCSP=y
CONFIG_BT_HCIUART_H4=y
CONFIG_BT_HCIUART_LL=y
CONFIG_BT_HCIUART_SERDEV=y
CONFIG_BT_HCIUSB=m
CONFIG_BT_HCIUSB_SCO=m
CONFIG_BT_HCIVHCI=m
CONFIG_BT_HIDP=m
CONFIG_BT_LEDS=y
CONFIG_BT_RFCOMM=y
CONFIG_BT_RFCOMM_TTY=y
CONFIG_CAN=y
CONFIG_CAN_SUN4I=y
CONFIG_CFG80211=y
CONFIG_CFG80211_DEBUGFS=y
CONFIG_CFG80211_INTERNAL_REGDB=y
CONFIG_CGROUPS=y
CONFIG_CHARGER_AXP20X=y
CONFIG_CMA=y
CONFIG_CPUFREQ_DT=y
CONFIG_CPU_FREQ=y
CONFIG_CPU_THERMAL=y
CONFIG_CRYPTO_AES_ARM=y
CONFIG_CRYPTO_AES_ARM_BS=y
CONFIG_CRYPTO_AES_ARM_CE=y
CONFIG_CRYPTO_AES_TI=y
CONFIG_CRYPTO_ANSI_CPRNG=y
CONFIG_CRYPTO_ARC4=y
CONFIG_CRYPTO_BLAKE2B=y
CONFIG_CRYPTO_BLAKE2S=y
CONFIG_CRYPTO_CHACHA20POLY1305=y
CONFIG_CRYPTO_CRC32_ARM_CE=y
CONFIG_CRYPTO_CRCT10DIF_ARM_CE=y
CONFIG_CRYPTO_CURVE25519=y
CONFIG_CRYPTO_DEV_ALLWINNER=y
CONFIG_CRYPTO_DEV_SUN4I_SS=y
CONFIG_CRYPTO_DEV_SUN8I_CE=y
CONFIG_CRYPTO_GHASH_ARM_CE=y
CONFIG_CRYPTO_LZ4=y
CONFIG_CRYPTO_PCRYPT=y
CONFIG_CRYPTO_SALSA20=y
CONFIG_CRYPTO_SHA1_ARM_CE=y
CONFIG_CRYPTO_SHA1_ARM_NEON=y
CONFIG_CRYPTO_SHA2_ARM_CE=y
CONFIG_CRYPTO_SHA512_ARM=y
CONFIG_CRYPTO_USER_API_AEAD=y
CONFIG_CRYPTO_USER_API_HASH=y
CONFIG_CRYPTO_USER_API_RNG=y
CONFIG_CRYPTO_USER_API_SKCIPHER=y
CONFIG_CRYPTO_ZSTD=y
CONFIG_DEBUG_FS=y
CONFIG_DEFAULT_DEVICE_TREE="sun8i-r40-bananapi-m2-ultra"
CONFIG_DEVTMPFS=y
CONFIG_DEVTMPFS_MOUNT=y
CONFIG_DMADEVICES=y
CONFIG_DMA_CMA=y
CONFIG_DMA_SUN6I=y
CONFIG_DRAM_CLK=576
CONFIG_DRAM_ODT_EN=y
CONFIG_DRAM_ZQ=3881979
CONFIG_DRM=y
CONFIG_DRM_DUMB_VGA_DAC=y
CONFIG_DRM_DW_HDMI_AHB_AUDIO=y
CONFIG_DRM_DW_HDMI_CEC=y
CONFIG_DRM_DW_HDMI_I2S_AUDIO=y
CONFIG_DRM_LIMA=y
CONFIG_DRM_LOAD_EDID_FIRMWARE=y
CONFIG_DRM_PANEL_LVDS=y
CONFIG_DRM_SUN4I=y
CONFIG_DRM_SUN4I_HDMI_CEC=y
CONFIG_DRM_SUN8I_DW_HDMI=y
CONFIG_DTC=y
CONFIG_ECRYPT_FS=y
CONFIG_ECRYPT_FS_MESSAGING=y
CONFIG_ENCRYPTED_KEYS=y
CONFIG_EXT4_FS=y
CONFIG_EXTCON=y
CONFIG_FB=y
CONFIG_FB_SIMPLE=y
CONFIG_FRAMEBUFFER_CONSOLE=y
CONFIG_FRAMEBUFFER_CONSOLE_DETECT_PRIMARY=y
CONFIG_GPIO_SYSFS=y
CONFIG_HIDRAW=y
CONFIG_HIGHMEM=y
CONFIG_HIGH_RES_TIMERS=y
CONFIG_HOSTAP=m
CONFIG_HOSTAP_FIRMWARE=y
CONFIG_HOSTAP_FIRMWARE_NVRAM=y
CONFIG_I2C_CHARDEV=y
CONFIG_I2C_MV64XXX=y
CONFIG_I2C_SUN6I_P2WI=y
CONFIG_IIO=y
CONFIG_INET=y
CONFIG_INPUT_AXP20X_PEK=y
CONFIG_INPUT_EVDEV=y
CONFIG_INPUT_MISC=y
CONFIG_INPUT_TOUCHSCREEN=y
CONFIG_IP_PNP=y
CONFIG_IP_PNP_BOOTP=y
CONFIG_IP_PNP_DHCP=y
CONFIG_IR_GPIO_CIR=y
CONFIG_IR_JVC_DECODER=y
CONFIG_IR_MCE_KBD_DECODER=y
CONFIG_IR_NEC_DECODER=y
CONFIG_IR_RC5_DECODER=y
CONFIG_IR_RC6_DECODER=y
CONFIG_IR_SANYO_DECODER=y
CONFIG_IR_SHARP_DECODER=y
CONFIG_IR_SONY_DECODER=y
CONFIG_IR_SUNXI=y
CONFIG_KEYBOARD_SUN4I_LRADC=y
CONFIG_LEDS_CLASS=y
CONFIG_LEDS_GPIO=y
CONFIG_LEDS_TRIGGERS=y
CONFIG_LEDS_TRIGGER_DEFAULT_ON=y
CONFIG_LEDS_TRIGGER_HEARTBEAT=y
CONFIG_LEDS_TRIGGER_NETDEV=y
CONFIG_LEDS_TRIGGER_ONESHOT=y
CONFIG_LEDS_TRIGGER_PANIC=y
CONFIG_LEDS_TRIGGER_PATTERN=y
CONFIG_LEDS_TRIGGER_TIMER=y
CONFIG_LED_TRIGGER_PHY=y
CONFIG_LIBERTAS=m
CONFIG_LIBERTAS_SDIO=m
CONFIG_LIBERTAS_SPI=m
CONFIG_LIBERTAS_USB=m
CONFIG_LIRC=y
CONFIG_LOGO=y
CONFIG_MAC80211=y
CONFIG_MAC80211_LEDS=y
CONFIG_MACH_SUN8I_R40=y
CONFIG_MACPWR="PA17"
CONFIG_MDIO_BUS_MUX_MULTIPLEXER=y
CONFIG_MEDIA_CAMERA_SUPPORT=y
CONFIG_MEDIA_CEC_RC=y
CONFIG_MEDIA_CEC_SUPPORT=y
CONFIG_MEDIA_CONTROLLER=y
CONFIG_MEDIA_CONTROLLER_REQUEST_API=y
CONFIG_MEDIA_RC_SUPPORT=y
CONFIG_MEDIA_SUPPORT=y
CONFIG_MEDIA_USB_SUPPORT=y
CONFIG_MFD_AC100=y
CONFIG_MFD_AXP20X_I2C=y
CONFIG_MFD_AXP20X_RSB=y
CONFIG_MFD_SUN4I_GPADC=y
CONFIG_MICREL_PHY=y
CONFIG_MMC0_CD_PIN="PH13"
CONFIG_MMC=y
CONFIG_MMC_SUNXI=y
CONFIG_MMC_SUNXI_SLOT_EXTRA=2
CONFIG_MODULES=y
CONFIG_MODULE_UNLOAD=y
CONFIG_MUSB_PIO_ONLY=y
CONFIG_MWIFIEX=m
CONFIG_MWIFIEX_SDIO=m
CONFIG_MWIFIEX_USB=m
CONFIG_NEON=y
CONFIG_NET=y
CONFIG_NETDEVICES=y
CONFIG_NEW_LEDS=y
CONFIG_NFS_FS=y
CONFIG_NFS_V3_ACL=y
CONFIG_NFS_V4=y
CONFIG_NLS_CODEPAGE_437=y
CONFIG_NLS_ISO8859_1=y
CONFIG_NOP_USB_XCEIV=y
CONFIG_NO_HZ=y
CONFIG_NR_CPUS=8
CONFIG_NR_DRAM_BANKS=1
CONFIG_NVMEM=y
CONFIG_NVMEM_SUNXI_SID=y
CONFIG_OF=y
CONFIG_P54_COMMON=m
CONFIG_P54_LEDS=y
CONFIG_P54_SPI=m
CONFIG_P54_USB=m
CONFIG_PACKET=y
CONFIG_PACKET_DIAG=y
CONFIG_PERF_EVENTS=y
CONFIG_PHYLIB=y
CONFIG_PHY_SUN4I_USB=y
CONFIG_PHY_SUN9I_USB=y
CONFIG_POWER_RESET=y
CONFIG_POWER_RESET_GPIO=y
CONFIG_POWER_RESET_GPIO_RESTART=y
CONFIG_POWER_SUPPLY=y
CONFIG_PRINTK_TIME=y
CONFIG_PROC_DEVICETREE=y
CONFIG_PWM=y
CONFIG_PWM_SUN4I=y
CONFIG_RC_CORE=y
CONFIG_RC_DECODERS=y
CONFIG_RC_DEVICES=y
CONFIG_REGULATOR=y
CONFIG_REGULATOR_AXP20X=y
CONFIG_REGULATOR_FIXED_VOLTAGE=y
CONFIG_REGULATOR_GPIO=y
CONFIG_REGULATOR_PWM=y
CONFIG_REGULATOR_SY8106A=y
CONFIG_REGULATOR_USERSPACE_CONSUMER=y
CONFIG_RFKILL=y
CONFIG_RFKILL_GPIO=m
CONFIG_RFKILL_INPUT=y
CONFIG_RFKILL_LEDS=y
CONFIG_RFKILL_PM=y
CONFIG_RFKILL_REGULATOR=m
CONFIG_RGMII=y
CONFIG_ROOT_NFS=y
CONFIG_RT2500USB=m
CONFIG_RT2800USB=m
CONFIG_RT2800USB_RT33XX=y
CONFIG_RT2800USB_RT35XX=y
CONFIG_RT2800USB_RT53XX=y
CONFIG_RT2800USB_RT55XX=y
CONFIG_RT2800_LIB=m
CONFIG_RT2X00=m
CONFIG_RT2X00_LIB=m
CONFIG_RT2X00_LIB_CRYPTO=y
CONFIG_RT2X00_LIB_FIRMWARE=y
CONFIG_RT2X00_LIB_LEDS=y
CONFIG_RT2X00_LIB_USB=m
CONFIG_RT73USB=m
CONFIG_RTC_CLASS=y
CONFIG_RTC_DRV_AC100=y
CONFIG_RTC_DRV_SUNXI=y
CONFIG_RTL8189FS=m
CONFIG_RTL8192CU=m
CONFIG_RTL8192C_COMMON=m
CONFIG_RTL8723BS=m
CONFIG_RTL8723BS_VQ0=m
CONFIG_RTLWIFI=m
CONFIG_SCSI=y
CONFIG_SCSI_AHCI=y
CONFIG_SECCOMP=y
CONFIG_SERIAL_8250=y
CONFIG_SERIAL_8250_CONSOLE=y
CONFIG_SERIAL_8250_DW=y
CONFIG_SERIAL_8250_NR_UARTS=8
CONFIG_SERIAL_8250_RUNTIME_UARTS=8
CONFIG_SERIAL_DEV_BUS=y
CONFIG_SERIAL_OF_PLATFORM=y
CONFIG_SMP=y
CONFIG_SND=y
CONFIG_SND_ALOOP=y
CONFIG_SND_AUDIO_GRAPH_CARD=y
CONFIG_SND_DUMMY=y
CONFIG_SND_HRTIMER=y
CONFIG_SND_MIXER_OSS=y
CONFIG_SND_OSSEMUL=y
CONFIG_SND_PCM_OSS=y
CONFIG_SND_SEQUENCER=y
CONFIG_SND_SEQUENCER_OSS=y
CONFIG_SND_SIMPLE_CARD=y
CONFIG_SND_SOC=y
CONFIG_SND_SOC_SPDIF=y
CONFIG_SND_SUN4I_CODEC=y
CONFIG_SND_SUN4I_I2S=y
CONFIG_SND_SUN4I_SPDIF=y
CONFIG_SND_SUN8I_CODEC=y
CONFIG_SND_SUN8I_CODEC_ANALOG=y
CONFIG_SND_USB_AUDIO=y
CONFIG_SOUND=y
CONFIG_SPI=y
CONFIG_SPI_SPIDEV=y
CONFIG_SPI_SUN4I=y
CONFIG_SPI_SUN6I=y
CONFIG_SPL=y
CONFIG_SPL_I2C_SUPPORT=y
CONFIG_STMMAC_ETH=y
CONFIG_SUN4I_EMAC=y
CONFIG_SUN8I_DE2_CCU=y
CONFIG_SUN8I_EMAC=y
CONFIG_SUN8I_R40_CCU=y
CONFIG_SUN8I_THERMAL=y
CONFIG_SUNXI_CCU_MUX=y
CONFIG_SUNXI_MBUS=y
CONFIG_SUNXI_RFKILL=y
CONFIG_SUNXI_WATCHDOG=y
CONFIG_SYS_RELOC_GD_ENV_ADDR=y
CONFIG_SYS_USB_EVENT_POLL_VIA_INT_QUEUE=y
CONFIG_THERMAL=y
CONFIG_TMPFS=y
CONFIG_TOUCHSCREEN_EDT_FT5X06=y
CONFIG_TOUCHSCREEN_SUN4I=y
CONFIG_UNIX=y
CONFIG_USB1_VBUS_PIN="PH23"
CONFIG_USB2_VBUS_PIN="PH23"
CONFIG_USB=y
CONFIG_USBIP_CORE=y
CONFIG_USBIP_HOST=y
CONFIG_USBIP_VHCI_HCD=y
CONFIG_USBIP_VUDC=y
CONFIG_USB_ACM=y
CONFIG_USB_ANNOUNCE_NEW_DEVICES=y
CONFIG_USB_CONFIGFS=y
CONFIG_USB_CONFIGFS_ACM=y
CONFIG_USB_CONFIGFS_ECM=y
CONFIG_USB_CONFIGFS_ECM_SUBSET=y
CONFIG_USB_CONFIGFS_EEM=y
CONFIG_USB_CONFIGFS_F_FS=y
CONFIG_USB_CONFIGFS_F_HID=y
CONFIG_USB_CONFIGFS_F_LB_SS=y
CONFIG_USB_CONFIGFS_F_MIDI=y
CONFIG_USB_CONFIGFS_F_PRINTER=y
CONFIG_USB_CONFIGFS_F_UAC1=y
CONFIG_USB_CONFIGFS_F_UAC2=y
CONFIG_USB_CONFIGFS_MASS_STORAGE=y
CONFIG_USB_CONFIGFS_NCM=y
CONFIG_USB_CONFIGFS_OBEX=y
CONFIG_USB_CONFIGFS_RNDIS=y
CONFIG_USB_CONFIGFS_SERIAL=y
CONFIG_USB_EHCI_HCD=y
CONFIG_USB_EHCI_HCD_PLATFORM=y
CONFIG_USB_ETH=y
CONFIG_USB_ETH_EEM=y
CONFIG_USB_GADGET=y
CONFIG_USB_HIDDEV=y
CONFIG_USB_LEDS_TRIGGER_USBPORT=y
CONFIG_USB_LED_TRIG=y
CONFIG_USB_MUSB_HDRC=y
CONFIG_USB_MUSB_SUNXI=y
CONFIG_USB_OHCI_HCD=y
CONFIG_USB_OHCI_HCD_PLATFORM=y
CONFIG_USB_PRINTER=y
CONFIG_USB_RTL8152=y
CONFIG_USB_SERIAL=y
CONFIG_USB_SERIAL_CH341=y
CONFIG_USB_SERIAL_CP210X=y
CONFIG_USB_SERIAL_FTDI_SIO=y
CONFIG_USB_SERIAL_OPTION=y
CONFIG_USB_SERIAL_PL2303=y
CONFIG_USB_STORAGE=y
CONFIG_USB_UAS=y
CONFIG_USB_VIDEO_CLASS=y
CONFIG_USB_WDM=y
CONFIG_USE_PREBOOT=y
CONFIG_U_SERIAL_CONSOLE=y
CONFIG_V4L_PLATFORM_DRIVERS=y
CONFIG_VALIDATE_FS_PARSER=y
CONFIG_VETH=y
CONFIG_VFAT_FS=y
CONFIG_VFP=y
CONFIG_VIDEO_SUNXI=y
CONFIG_VIDEO_SUNXI_CEDRUS=m
CONFIG_VIDEO_SUNXI_CEDRUS=y
CONFIG_VIDEO_V4L2_SUBDEV_API=y
CONFIG_VIRTUALIZATION=y
CONFIG_VLAN_8021Q=y
CONFIG_VLAN_8021Q_GVRP=y
CONFIG_VLAN_8021Q_MVRP=y
CONFIG_WILINK_PLATFORM_DATA=y
CONFIG_WIREGUARD=y
CONFIG_WIRELESS=y
CONFIG_WIRELESS_EXT=y
CONFIG_WL1251=m
CONFIG_WL1251_SDIO=m
CONFIG_WL1251_SPI=m
CONFIG_WL12XX=m
CONFIG_WL18XX=m
CONFIG_WLCORE=m
CONFIG_WLCORE_SDIO=m
CONFIG_WLCORE_SPI=m
CONFIG_WL_TI=y
CONFIG_ZD1211RW=m
```
